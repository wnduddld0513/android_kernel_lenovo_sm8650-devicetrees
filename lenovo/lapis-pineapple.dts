// SPDX-License-Identifier: GPL-2.0-only
/*
 * (C) 2026 The LineageOS Project
 *
 * Base dtb of the TB520FU for pineapple: Qualcomm pineapple.dts plus lapis-soc.dtsi.
 */

#include "../qcom/pineapple.dts"
#include "lapis-soc.dtsi"
