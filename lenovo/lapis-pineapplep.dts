// SPDX-License-Identifier: GPL-2.0-only
/*
 * (C) 2026 The LineageOS Project
 *
 * Base dtb of the TB520FU for pineapplep: Qualcomm pineapplep.dts plus lapis-soc.dtsi.
 */

#include "../qcom/pineapplep.dts"
#include "lapis-soc.dtsi"
