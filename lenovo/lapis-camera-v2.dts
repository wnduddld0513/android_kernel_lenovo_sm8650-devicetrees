// SPDX-License-Identifier: GPL-2.0-only
/*
 * (C) 2026 The LineageOS Project
 *
 * Qualcomm pineapple camera overlay (v2) for the TB520FU with CCI1 master 0 only,
 * see lapis-camera-cci.dtsi.
 */

#include "../qcom/camera/pineapple-camera-v2.dts"
#include "lapis-camera-cci.dtsi"
