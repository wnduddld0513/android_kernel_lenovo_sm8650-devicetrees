// SPDX-License-Identifier: GPL-2.0-only
/*
 * (C) 2026 The LineageOS Project
 *
 * Qualcomm hw fence component overlay as built into the stock 18.5.10.037 dtb.
 */

#include "../../qcom/mm/hw_fence/pineapple-hw-fence.dts"
