// SPDX-License-Identifier: GPL-2.0-only
/*
 * (C) 2026 The LineageOS Project
 *
 * Qualcomm ubwcp component overlay as built into the stock 18.5.10.037 dtb.
 */

#include "../../qcom/mm-sys/ubwcp-devicetree/pineapple-ubwcp.dts"
