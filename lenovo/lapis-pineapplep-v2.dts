// SPDX-License-Identifier: GPL-2.0-only
/*
 * (C) 2026 The LineageOS Project
 *
 * Base dtb of the TB520FU for pineapplep-v2: Qualcomm pineapplep-v2.dts plus lapis-soc.dtsi.
 */

#include "../qcom/pineapplep-v2.dts"
#include "lapis-soc.dtsi"
